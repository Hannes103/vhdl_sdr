/include/ "system-conf.dtsi"
/ {
	model = "Zynq Eclipse Z7 Development Board";
	compatible = "digilent,zynq-eclipsez7", "xlnx,zynq-7000";

	usb_phy0: usb_phy@0 {
		compatible = "ulpi-phy";
		#phy-cells = <0>;
		reg = <0xe0002000 0x1000>;
		view-port = <0x0170>;
		drv-vbus;
	};
};

&i2c1 {
        status = "okay";
        device-name = "pmcu-i2c";
};

&usb0 {
	dr_mode = "host";
	status 	= "okay";
	usb-phy = <&usb_phy0>;
};
